## conf/layer.conf
```bitbake
# We have a conf and classes directory, add to BBPATH
BBPATH .= ":${LAYERDIR}"

# We have recipes-* directories, add to BBFILES
BBFILES += "${LAYERDIR}/recipes-*/*/*.bb \
            ${LAYERDIR}/recipes-*/*/*.bbappend"

BBFILE_COLLECTIONS += "resptech-vmware"
BBFILE_PATTERN_resptech-vmware = "^${LAYERDIR}/"
BBFILE_PRIORITY_resptech-vmware = "6"

LAYERDEPENDS_resptech-vmware = "core"
LAYERSERIES_COMPAT_resptech-vmware = "dunfell"
```
